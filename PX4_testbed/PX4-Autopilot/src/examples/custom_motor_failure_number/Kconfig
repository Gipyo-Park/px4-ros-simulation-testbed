## PX4_testbed/PX4-Autopilot/src/examples/custom_motor_failure_number/Kconfig
```kconfig
 menuconfig EXAMPLES_CUSTOM_MOTOR_FAILURE_NUMBER
 bool "custom_motor_failure_number"
 default n
 ---help---
 	Enable custom_motor_failure_number
```
